## drivers/spi/st7735/Kconfig
```kconfig
#
# SPI driver configuration
#
# NOTE:  the reason this doesn't show SPI slave support is mostly that
# nobody's needed a slave side API yet.  The master-role API is not
# fully appropriate there, so it'd need some thought to do well.
#

config SPI_ST7735S
	tristate "ST7735S Based SPI LCD Driver"
	depends on GENERIC_GPIO
	help
	  st7735s tft lcd driver
```
